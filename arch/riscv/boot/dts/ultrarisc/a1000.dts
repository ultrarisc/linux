/* 
* SPDX-License-Identifier: GPL-2.0+
*
* Copyright (c) 2019-2022 UltraRisc,Inc
*
* Authors:
*   Wang yantong <wangyantong@ultrarisc.com>
*/

#include "a1000-xilinx.dtsi"


/ {

&uart0 {
        status = "okay";
};

&spi0 {
        status = "disable";
};

}

