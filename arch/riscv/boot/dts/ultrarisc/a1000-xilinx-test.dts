/* 
* SPDX-License-Identifier: GPL-2.0+
*
* Copyright (c) 2019-2023 UltraRISC
*
*/

#include "a1000-xilinx.dtsi"


/ {

        &uart0 {
                status = "okay";
        };

        &spi0 {
                status = "disable";
        };

}

